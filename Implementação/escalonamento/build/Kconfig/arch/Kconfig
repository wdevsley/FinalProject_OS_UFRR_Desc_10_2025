## Implementação/escalonamento/build/Kconfig/arch/Kconfig
```kconfig
# Load Zephyr Arch Kconfig descriptions.
osource "/home/luciano/zephyrproject/zephyr/arch/rx/Kconfig"
osource "/home/luciano/zephyrproject/zephyr/arch/x86/Kconfig"
osource "/home/luciano/zephyrproject/zephyr/arch/xtensa/Kconfig"
osource "/home/luciano/zephyrproject/zephyr/arch/sparc/Kconfig"
osource "/home/luciano/zephyrproject/zephyr/arch/riscv/Kconfig"
osource "/home/luciano/zephyrproject/zephyr/arch/posix/Kconfig"
osource "/home/luciano/zephyrproject/zephyr/arch/mips/Kconfig"
osource "/home/luciano/zephyrproject/zephyr/arch/arm64/Kconfig"
osource "/home/luciano/zephyrproject/zephyr/arch/arm/Kconfig"
osource "/home/luciano/zephyrproject/zephyr/arch/arc/Kconfig"
```

## Implementação/escalonamento/build/Kconfig/boards/Kconfig.defconfig
```kconfig
# Load Zephyr board defconfig descriptions.
osource "/home/luciano/zephyrproject/zephyr/boards/qemu/x86/Kconfig.defconfig"
```

## Implementação/escalonamento/build/Kconfig/boards/Kconfig.qemu_x86
```kconfig
# Load board Kconfig descriptions.
osource "/home/luciano/zephyrproject/zephyr/boards/qemu/x86/Kconfig.qemu_x86"
```

## Implementação/escalonamento/build/Kconfig/boards/Kconfig.sysbuild
```kconfig
# Load Sysbuild board Kconfig descriptions.
osource "/home/luciano/zephyrproject/zephyr/boards/qemu/x86/Kconfig.sysbuild"
```
